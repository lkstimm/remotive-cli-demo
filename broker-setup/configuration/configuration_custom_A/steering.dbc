VERSION ""

NS_ :

BS_:

BU_: ECU_Steering Gateway

BO_ 100 SteeringCommand: 8 Gateway
 SG_ SteeringAngle : 0|16@1+ (-2000,0.1) [-2000|2000] "degrees" ECU_Steering
 SG_ SteeringSpeed : 16|8@1+ (0,1) [0|255] "deg/s" ECU_Steering

BO_ 200 SteeringStatus: 8 ECU_Steering
 SG_ CurrentAngle : 0|16@1+ (-2000,0.1) [-2000|2000] "degrees" Gateway
 SG_ ECU_Ready : 16|1@1+ (0,1) [0|1] "" Gateway

CM_ BU_ ECU_Steering "Steering ECU that responds to steering commands";
CM_ BU_ Gateway "Gateway that publishes steering commands";
CM_ BO_ 100 "Steering command message from gateway";
CM_ BO_ 200 "Steering status message from ECU";
CM_ SG_ 100 SteeringAngle "Desired steering angle in degrees";
CM_ SG_ 100 SteeringSpeed "Speed of steering movement";
CM_ SG_ 200 CurrentAngle "Current actual steering angle";
CM_ SG_ 200 ECU_Ready "ECU ready status";
